## src/firmware/esp32/main/Kconfig.projbuild
```kconfig
menu "Rato Borrachudo"

    config RATO_BANCADA
        bool "Modo bancada (placa sem sensores nem motores)"
        default n
        help
            Para testar a telemetria BLE numa placa solta, sem o robô montado.
            Pula o auto-teste do IMU e do INA219, simula o movimento com atrasos
            fixos (sem motores nem encoders) e envia valores fixos de energia.
            Os ToF já estão como stub (sem paredes), então a corrida percorre o
            labirinto aberto até o objetivo. NUNCA ligar na placa do robô.

    config RATO_FIOS_MOTORES_TROCADOS
        bool "Fios dos motores trocados (robô montado na bancada)"
        depends on IDF_TARGET_ESP32S3
        default y
        help
            No robô montado na bancada, os fios dos motores foram soldados trocados em
            relação ao esquemático 4.3: a roda esquerda está nos pinos do motor 1
            (16/15) e a direita nos do motor 2 (6/5). Os encoders seguem o esquemático
            (esquerdo 41/40, direito 38/39), medido em 07/11. Ligada, o firmware segue
            essa montagem. Desligue quando o robô passar para a PCB feita pelo
            esquemático.

    config RATO_LOG_RETA
        bool "Logar a reta e as curvas no fim de cada movimento (calibração)"
        default n
        help
            Para calibrar o ganho da reta e a curva na pista (com o cabo USB). No fim de
            cada advanceCell, uma linha com a tag "reta": pulsos de cada roda, erro final
            e máximo, maior correção e quantos passos de 1 ms ficaram no limite. No fim
            de cada curva, uma linha com a tag "curva": ângulo do giroscópio ao frear e
            depois do freio, tempo e pulsos medidos contra os esperados sem patinar. Não
            muda o movimento; o log leva alguns ms durante a frenagem.

    config RATO_CENTRALIZAR_PAREDES
        bool "Centralizar pelas paredes laterais na reta (RF-44, experimental)"
        depends on !RATO_BANCADA
        default n
        help
            Na reta, soma ao erro dos encoders o deslocamento lateral lido pelos ToF
            laterais (domain/WallCentering, docs/rf44-centralizacao.md). Ganhos iniciais
            NÃO calibrados em RobotParameters.hpp (kWallCentering). Desligada, o
            advanceCell anda só pelos encoders, como antes.

endmenu
```
